## arch/mips/xburst/soc-m200/chip-m200/watch/Kconfig
```kconfig
choice
	prompt "BOARD type"
	depends on BOARD_WATCH
	default WATCH_NEWTON2


config WATCH_NEWTON2
       bool "watch newton2"
       depends on BOARD_WATCH

config WATCH_AW808
       bool "watch aw808"
       depends on BOARD_WATCH
endchoice

if WATCH_AW808
source "arch/mips/xburst/soc-m200/chip-m200/watch/aw808/Kconfig"
endif

config BOARD_NAME
	string "BOARD_NAME"
	default "newton2" if WATCH_NEWTON2
	default "aw808" if WATCH_AW808
```

## arch/mips/xburst/soc-m200/chip-m200/watch/a2/Kconfig
```kconfig
choice
	prompt "Select hardware version"
	depends on WATCH_A2
	default A2_HW_V10

config A2_HW_V10
       bool "a2 hardware version v1.0"
       depends on WATCH_A2

endchoice
```

## arch/mips/xburst/soc-m200/chip-m200/watch/swimbot/Kconfig
```kconfig
choice
	prompt "Select hardware version"
	depends on WATCH_SWIMBOT
	default SWIMBOT_HW

config SWIMBOT_HW
       bool "swimbot hardware version swimbot"
       depends on WATCH_SWIMBOT
endchoice
```

## drivers/mfd/sensor_hub/Kconfig
```kconfig
#
# "sensor hub devices"
#

menu "Ingenic SensorHub support"
	depends on INPUT

config SENSOR_HUB
	tristate "Ingenic SensorHub"
	depends on INPUT
	default n
	---help---
	  If unsure, say Y.
if SENSOR_HUB
choice
	prompt "Select SensorHub communication Interface"
	depends on SENSOR_HUB
	default SENSOR_HUB_I2C
config SENSOR_HUB_I2C
	tristate "SensorHub Interface I2C"
	depends on I2C && SENSOR_HUB
	default y
	---help---
	  Say Y here to enable I2C bus interface to SensorHub
	  If unsure, say Y.
endchoice
endif

endmenu
```

## drivers/misc/bcm4774_sensorhub/Kconfig
```kconfig
config BCM4774_ENABLE_SYS
    bool "bcm4774 create sysfs to control nSTANDBY pin"
    default n
    help
      Say Y here to include support for lhd process pull nSTANDBY
      GPIO up and enable clk32 to enable bcm4774 ic when starts.
      if use the ic module, the conf must be chosen.
```

## drivers/nfc/bnsem628/Kconfig
```kconfig
config NFC_BNSEM628
	tristate "MPS BNSEM505-628 driver"
	depends on NFC
	select CRC_CCITT
	default n
	---help---
	  bnsem505-628 core driver.

	  To compile this driver as a module, choose m here. The module will
	  be called bnsem628.
	  Say N if unsure.
```

## drivers/sensors/frizz/Kconfig
```kconfig
if SENSORS
config INPUT_FRIZZ
	bool "Frizz sensor"
	default n
	help
	  If you select yes here that will support Mega Chips's
	  sensor hub frizz for your product.

	  To compile this driver as a module, choose M here: the
	  module will be called FRIZZ.


config INPUT_FRIZZ_POLLING
	bool "Polling-mode of Frizz sensor"
	default n
	help
	  Say Y here if you want support for polling-mode of the Frizz sensorhub
	  device.

	  To compile this driver as a module, choose M here: the
	  module will be called FRIZZ.
config INPUT_FRIZZ_FW_COMMAND_TEST
	bool "Fw command test of Frizz sensor"
	default n
	help
	  Say Y here if you want support for fw command test of the Frizz sensorhub
	  device.

	  To compile this driver as a module, choose M here: the
	  module will be called FRIZZ.

endif
```

## drivers/slpt/Kconfig
```kconfig
menu "Slpt Drivers"

config SLPT
	bool "slpt driver"
	select FB_DISPLAY_ALWAYS_ON
	select LCD_BRIGHTNESS_ALWAYS_ON
	help

config SLPT_MAP_TO_KSEG2
	bool "slpt will map to kseg2 address"
	default y

config SLPT_SHUTDOWN
    bool "entry slpt mode when system low-power shutdown"
    default n
    depends on SLPT
    help
      entry slpt mode when system low-power shutdown

config SLPT_POWERDOWN_DEVICE
    bool "Power down some device when entry slpt mode"
    default n
    depends on SLPT
    help
	  In order to equipment used for longer time
	  We will shut down some devices

config SLPT_LOW_BATTERY_VOLTAGE
	int "low battery voltage(mV) value for slpt"
	default 3624
	depends on SLPT

config SLPT_LOW_BATTERY_WARN_VOLTAGE
	int "low battery warn voltage(mV) value for slpt"
	default 3408
	depends on SLPT

config SLPT_CHARGER_GPIO
	int "charger gpio for slpt"
	default -1
	depends on SLPT

config SLPT_CHARGER_LEVEL
	int "charger gpio valid level for slpt"
	default -1
	depends on SLPT

endmenu
```
